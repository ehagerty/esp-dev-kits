.. toctree::
    :hidden:
    :caption: {IDF_TARGET_NAME} 系列开发板

    ESP32-S31-Function-CoreBoard-1 <esp32-s31-function-coreboard-1/index>
    ESP32-S31-Korvo-1 <esp32-s31-korvo-1/index>


=================================================   ====================
            **{IDF_TARGET_NAME} 系列开发板**                                 
-------------------------------------------------   --------------------
|ESP32-S31-Function-CoreBoard-1|_                   |ESP32-S31-Korvo-1|_
-------------------------------------------------   --------------------
`ESP32-S31-Function-CoreBoard-1`_                   `ESP32-S31-Korvo-1`_
=================================================   ====================

.. |ESP32-S31-Function-CoreBoard-1| image:: ../_static/esp32-s31-function-coreboard-1/esp32-s31-function-coreboard-1-isometric.png
.. _ESP32-S31-Function-CoreBoard-1: esp32-s31-function-coreboard-1/index.html

.. |ESP32-S31-Korvo-1| image:: ../_static/esp32-s31-korvo-1/esp32-s31-korvo-1-isometric.png
.. _ESP32-S31-Korvo-1: esp32-s31-korvo-1/index.html
